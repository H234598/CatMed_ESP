/*******************************************************************************
 * Size: 68 px
 * Bpp: 2
 * Opts: --font /usr/share/fonts/dejavu-sans-fonts/DejaVuSansCondensed.ttf -r 0x30-0x3a,0x2d --size 68 --bpp 2 --no-compress --format lvgl --lv-font-name katmed_font_68 --output firmware/components/katmed_ui/katmed_font_68.c
 ******************************************************************************/

#ifdef LV_LVGL_H_INCLUDE_SIMPLE
#include "lvgl.h"
#else
#include "lvgl/lvgl.h"
#endif

#ifndef KATMED_FONT_68
#define KATMED_FONT_68 1
#endif

#if KATMED_FONT_68

/*-----------------
 *    BITMAPS
 *----------------*/

/*Store the image of the glyphs*/
static LV_ATTRIBUTE_LARGE_CONST const uint8_t clock_68_glyph_bitmap[] = {
    /* U+002D "-" */
    0x15, 0x55, 0x55, 0x55, 0x43, 0xff, 0xff, 0xff,
    0xfc, 0x3f, 0xff, 0xff, 0xff, 0xc3, 0xff, 0xff,
    0xff, 0xfc, 0x3f, 0xff, 0xff, 0xff, 0xc3, 0xff,
    0xff, 0xff, 0xfc,

    /* U+0030 "0" */
    0x0, 0x0, 0x0, 0x1, 0x0, 0x0, 0x0, 0x0,
    0x0, 0x0, 0x1b, 0xff, 0xf9, 0x0, 0x0, 0x0,
    0x0, 0x7, 0xff, 0xff, 0xff, 0x40, 0x0, 0x0,
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    0x40, 0x0, 0x0,

    /* U+0031 "1" */
    0x0, 0x0, 0x5, 0xaa, 0x80, 0x0, 0x0, 0x0,
    0x6, 0xff, 0xff, 0xd0, 0x0, 0x0, 0x1a, 0xff,
    0xff, 0xff, 0xd0, 0x0, 0x0, 0x7f, 0xff, 0xff,
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    0xff, 0xff, 0xff, 0xff, 0xff, 0xfd,

    /* U+0032 "2" */
    0x0, 0x0, 0x5, 0xa9, 0x40, 0x0, 0x0, 0x0,
    0x1, 0xff, 0xff, 0xff, 0x90, 0x0, 0x0, 0x1f,
    0xff, 0xff, 0xff, 0xff, 0x0, 0x0, 0xbf, 0xff,
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    0xff, 0xfc,

    /* U+0033 "3" */
    0x0, 0x1, 0x6b, 0xff, 0xe9, 0x0, 0x0, 0x0,
    0x6, 0xff, 0xff, 0xff, 0xff, 0x80, 0x0, 0x0,
    0xff, 0xff, 0xff, 0xff, 0xff, 0xe0, 0x0, 0x3,
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    0x40, 0x0, 0x0, 0x0,

    /* U+0034 "4" */
    0x0, 0x0, 0x0, 0x0, 0x2, 0xff, 0xfc, 0x0,
    0x0, 0x0, 0x0, 0x0, 0x0, 0x7f, 0xff, 0xc0,
    0x0, 0x0, 0x0, 0x0, 0x0, 0xf, 0xff, 0xfc,
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    0x0,

    /* U+0035 "5" */
    0x2, 0xaa, 0xaa, 0xaa, 0xaa, 0xaa, 0xa0, 0x0,
    0x7f, 0xff, 0xff, 0xff, 0xff, 0xff, 0x40, 0x7,
    0xff, 0xff, 0xff, 0xff, 0xff, 0xf4, 0x0, 0x7f,
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    0x6, 0xbf, 0xff, 0x94, 0x0, 0x0, 0x0,

    /* U+0036 "6" */
    0x0, 0x0, 0x0, 0x6, 0xff, 0xf9, 0x0, 0x0,
    0x0, 0x0, 0x1, 0xff, 0xff, 0xff, 0xf9, 0x0,
    0x0, 0x0, 0xf, 0xff, 0xff, 0xff, 0xff, 0x0,
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    0x0, 0x0, 0x1, 0xbf, 0xfe, 0x40, 0x0, 0x0,

    /* U+0037 "7" */
    0xaa, 0xaa, 0xaa, 0xaa, 0xaa, 0xaa, 0xaa, 0x7f,
    0xff, 0xff, 0xff, 0xff, 0xff, 0xff, 0xef, 0xff,
    0xff, 0xff, 0xff, 0xff, 0xff, 0xfb, 0xff, 0xff,
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    0x0, 0x0, 0x0,

    /* U+0038 "8" */
    0x0, 0x0, 0x0, 0x1, 0x0, 0x0, 0x0, 0x0,
    0x0, 0x0, 0x6f, 0xff, 0xfe, 0x40, 0x0, 0x0,
    0x0, 0x2f, 0xff, 0xff, 0xff, 0xe0, 0x0, 0x0,
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    0x90, 0x0, 0x0,

    /* U+0039 "9" */
    0x0, 0x0, 0x0, 0x1, 0x40, 0x0, 0x0, 0x0,
    0x0, 0x0, 0x7, 0xff, 0xff, 0x80, 0x0, 0x0,
    0x0, 0x0, 0xbf, 0xff, 0xff, 0xf8, 0x0, 0x0,
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    0x0, 0x0, 0x6f, 0xff, 0x90, 0x0, 0x0, 0x0,

    /* U+003A ":" */
    0xff, 0xf7, 0xff, 0xdf, 0xff, 0x7f, 0xfd, 0xff,
    0xf7, 0xff, 0xdf, 0xff, 0x7f, 0xfd, 0x55, 0x50,
    0x0, 0x0, 0x0, 0x0, 0x0, 0x0, 0x0, 0x0,
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    0xff, 0xf7, 0xff, 0xdf, 0xff, 0x40
};


/*---------------------
 *  GLYPH DESCRIPTION
 *--------------------*/

static const lv_font_fmt_txt_glyph_dsc_t clock_68_glyph_dsc[] = {
    {.bitmap_index = 0, .adv_w = 0, .box_w = 0, .box_h = 0, .ofs_x = 0, .ofs_y = 0} /* id = 0 reserved */,
    {.bitmap_index = 0, .adv_w = 353, .box_w = 18, .box_h = 6, .ofs_x = 2, .ofs_y = 16},
    {.bitmap_index = 27, .adv_w = 623, .box_w = 31, .box_h = 52, .ofs_x = 4, .ofs_y = -1},
    {.bitmap_index = 430, .adv_w = 623, .box_w = 28, .box_h = 50, .ofs_x = 6, .ofs_y = 0},
    {.bitmap_index = 780, .adv_w = 623, .box_w = 29, .box_h = 51, .ofs_x = 4, .ofs_y = 0},
    {.bitmap_index = 1150, .adv_w = 623, .box_w = 31, .box_h = 51, .ofs_x = 4, .ofs_y = -1},
    {.bitmap_index = 1546, .adv_w = 623, .box_w = 34, .box_h = 50, .ofs_x = 2, .ofs_y = 0},
    {.bitmap_index = 1971, .adv_w = 623, .box_w = 30, .box_h = 51, .ofs_x = 4, .ofs_y = -1},
    {.bitmap_index = 2354, .adv_w = 623, .box_w = 32, .box_h = 51, .ofs_x = 4, .ofs_y = -1},
    {.bitmap_index = 2762, .adv_w = 623, .box_w = 29, .box_h = 50, .ofs_x = 5, .ofs_y = 0},
    {.bitmap_index = 3125, .adv_w = 623, .box_w = 31, .box_h = 52, .ofs_x = 4, .ofs_y = -1},
    {.bitmap_index = 3528, .adv_w = 623, .box_w = 32, .box_h = 52, .ofs_x = 3, .ofs_y = -1},
    {.bitmap_index = 3944, .adv_w = 330, .box_w = 7, .box_h = 35, .ofs_x = 7, .ofs_y = 0}
};

/*---------------------
 *  CHARACTER MAPPING
 *--------------------*/

static const uint8_t clock_68_glyph_id_ofs_list_0[] = {
    0, 0, 0, 1, 2, 3, 4, 5,
    6, 7, 8, 9, 10, 11
};

/*Collect the unicode lists and glyph_id offsets*/
static const lv_font_fmt_txt_cmap_t clock_68_cmaps[] =
{
    {
        .range_start = 45, .range_length = 14, .glyph_id_start = 1,
        .unicode_list = NULL, .glyph_id_ofs_list = clock_68_glyph_id_ofs_list_0, .list_length = 14, .type = LV_FONT_FMT_TXT_CMAP_FORMAT0_FULL
    }
};



/*--------------------
 *  ALL CUSTOM DATA
 *--------------------*/

#if LVGL_VERSION_MAJOR == 8
/*Store all the custom data of the font*/
static  lv_font_fmt_txt_glyph_cache_t clock_68_cache;
#endif

#if LVGL_VERSION_MAJOR >= 8
static const lv_font_fmt_txt_dsc_t clock_68_font_dsc = {
#else
static lv_font_fmt_txt_dsc_t clock_68_font_dsc = {
#endif
    .glyph_bitmap = clock_68_glyph_bitmap,
    .glyph_dsc = clock_68_glyph_dsc,
    .cmaps = clock_68_cmaps,
    .kern_dsc = NULL,
    .kern_scale = 0,
    .cmap_num = 1,
    .bpp = 2,
    .kern_classes = 0,
    .bitmap_format = 0,
#if LVGL_VERSION_MAJOR == 8
    .cache = &clock_68_cache
#endif
};



/*-----------------
 *  PUBLIC FONT
 *----------------*/

/*Initialize a public general font descriptor*/
#if LVGL_VERSION_MAJOR >= 8
const lv_font_t katmed_font_68 = {
#else
lv_font_t katmed_font_68 = {
#endif
    .get_glyph_dsc = lv_font_get_glyph_dsc_fmt_txt,    /*Function pointer to get glyph's data*/
    .get_glyph_bitmap = lv_font_get_bitmap_fmt_txt,    /*Function pointer to get glyph's bitmap*/
    .line_height = 52,          /*The maximum line height required by the font*/
    .base_line = 1,             /*Baseline measured from the bottom of the line*/
#if !(LVGL_VERSION_MAJOR == 6 && LVGL_VERSION_MINOR == 0)
    .subpx = LV_FONT_SUBPX_NONE,
#endif
#if LV_VERSION_CHECK(7, 4, 0) || LVGL_VERSION_MAJOR >= 8
    .underline_position = -1,
    .underline_thickness = 3,
#endif
    .dsc = &clock_68_font_dsc,          /*The custom font data. Will be accessed by `get_glyph_bitmap/dsc` */
#if LV_VERSION_CHECK(8, 2, 0) || LVGL_VERSION_MAJOR >= 9
    .fallback = NULL,
#endif
    .user_data = NULL,
};



#endif /*#if KATMED_FONT_68*/
